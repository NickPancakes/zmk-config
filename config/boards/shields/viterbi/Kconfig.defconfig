## config/boards/shields/viterbi/Kconfig.defconfig
```kconfig
# Copyright (c) 2020 The ZMK Contributors
# SPDX-License-Identifier: MIT

if SHIELD_VITERBI_LEFT

config ZMK_KEYBOARD_NAME
    default "Viterbi"

config USB_DEVICE_PRODUCT
	default "Viterbi USB"

config BT_DEVICE_NAME
	default "Viterbi BT"

config ZMK_SPLIT_BLE_ROLE_CENTRAL
    default y

endif

if SHIELD_VITERBI_LEFT || SHIELD_VITERBI_RIGHT

config ZMK_SPLIT
    default y

endif
```

## config/west.yml
```yaml
manifest:
  remotes:
    - name: zmkfirmware
      url-base: https://github.com/zmkfirmware
    - name: petejohanson
      url-base: https://github.com/petejohanson
  projects:
    - name: zmk
      remote: zmkfirmware
      revision: main
      import: app/west.yml
    - name: zmk-3.4
      remote: petejohanson
      revision: core/zephyr-3.4-update
      import: app/west.yml
  self:
    path: config
```
